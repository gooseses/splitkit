## config/boards/shields/Kconfig.shield
```kconfig
config SHIELD_SPLITKIT_LEFT
    def_bool $(shields_list_contains,splitkit_left)

config SHIELD_SPLITKIT_RIGHT
    def_bool $(shields_list_contains,splitkit_right)
```

## config/boards/shields/splitkit/Kconfig.defconfig
```kconfig
if SHIELD_SPLITKIT_LEFT

config ZMK_KEYBOARD_NAME
    default "Splitkit"

config ZMK_SPLIT_ROLE_CENTRAL
    default y

endif

if SHIELD_SPLITKIT_LEFT || SHIELD_SPLITKIT_RIGHT

config ZMK_SPLIT
    default y

endif
```
